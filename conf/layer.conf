## conf/layer.conf
```bitbake
# We have a conf and classes directory, add to BBPATH
BBPATH .= ":${LAYERDIR}"

# We have recipes-* directories, add to BBFILES
BBFILES += "${LAYERDIR}/recipes-*/*/*.bb \
            ${LAYERDIR}/recipes-*/*/*.bbappend"

BBFILE_COLLECTIONS += "meta-chimeratk"
BBFILE_PATTERN_meta-chimeratk = "^${LAYERDIR}/"
BBFILE_PRIORITY_meta-chimeratk = "6"

LAYERDEPENDS_meta-chimeratk = "core openembedded-layer meta-python"
LAYERRECOMMENDS_meta-chimeratk = "qt6-layer tango"
LAYERSERIES_COMPAT_meta-chimeratk = "mickledore nanbield scarthgap styhead walnascar"

BBFILES_DYNAMIC += "\
    qt6-layer:${LAYERDIR}/dynamic-layers/qt6-layer/*/*/*.bb \
    qt6-layer:${LAYERDIR}/dynamic-layers/qt6-layer/*/*/*.bbappend \
    tango:${LAYERDIR}/dynamic-layers/tango/*/*/*.bb \
    tango:${LAYERDIR}/dynamic-layers/tango/*/*/*.bbappend \
"
```

## meta-tango-compat/conf/layer.conf
```bitbake
BBPATH ?= ""
# We have a conf and classes directory, add to BBPATH
BBPATH .= ":${LAYERDIR}"
# We have recipe directories, add to BBFILES
BBFILES += "${LAYERDIR}/recipes-*/*/*.bbappend"

BBFILE_COLLECTIONS += "tango-compat"
BBFILE_PATTERN_tango-compat := "^${LAYERDIR}/"
BBFILE_PRIORITY_tango-compat = "10"

LAYERSERIES_COMPAT_tango-compat = "walnascar mickledore nanbield scarthgap styhead"

# The tango layer for dunfell works just fine on langdale
LAYERSERIES_COMPAT_tango = "walnascar mickledore nanbield scarthgap styhead"
```
